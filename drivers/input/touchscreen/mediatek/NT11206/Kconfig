## drivers/input/touchscreen/mediatek/NT11206/Kconfig
```kconfig
#
# Touchscreen driver configuration
#
config TOUCHSCREEN_MTK_NT11206
	bool "NT11206 for Mediatek package"
	default n
	help
	  Say Y here if you have NT11206 touch panel.

	  If unsure, say N.

	  To compile this dirver as a module, choose M here: the
	  module will be called.
```

## drivers/misc/mediatek/accelerometer/bma150/Kconfig
```kconfig
config MTK_BMA150
	bool "MTK_BMA150 for MediaTek package"
	default n
	help
	  It support different accelerometer sensor.
          If this option is set,
	  it will support
          MTK_BMA150 Accelerometer.
```

## drivers/misc/mediatek/alsps/stk3x1x/Kconfig
```kconfig
config MTK_STK3X1X
	bool "MTK_STK3X1X for MediaTek package"
	default n
	help
	It support different type sensor
	in this platform. If this option
	is set, it will support ambient
	and light sensor stk3x1x.
```
